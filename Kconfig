## Kconfig
```kconfig
menu "I2C Drivers"
    menu "Temperature sensors"
        config I2C_DEVICES_MS5837
            bool "MS5837 temperature (and pressure) sensor"
            help
                Enable the MS5837 I2C driver

        config I2C_DEVICES_SHT21
            bool "SHT21 temperature sensor"
            help
                Enable the SHT21 I2C driver
                
        config I2C_DEVICES_SHT3
            bool "SHT3x temperature sensor"
            help
                Enable the SHT3x I2C driver

        config I2C_DEVICES_SHTC3
            bool "SHTC3 temperature sensor"
            help
                Enable the SHTC3 I2C driver


        config I2C_DEVICES_SHT4
            bool "SHT4x temperature sensor"
            help
                Enable the SHT4x I2C driver

        config I2C_DEVICES_ZS05
            bool "ZS05 temperature sensor"
            help
                Enable the ZS05 I2C driver
    endmenu

    menu "Eeproms"
        config I2C_DEVICES_EEPROM_24LC16
            bool "MCP24LC16"
            help
                Enable the MCP24LC16 RTC driver

        config I2C_DEVICES_EEPROM_24LC1025
            bool "MCP24LC1025"
            help
                Enable the MCP24LC1025 RTC driver

        config I2C_DEVICES_EEPROM_24AA32
            bool "MCP24AA32"
            help
                Enable the MCP24AA32 RTC driver
    endmenu

    menu "Real time clocks"
        config I2C_DEVICES_STRUCT_TM_CONVERSION
            bool "Enable struct tm to rtc_time_t conversion"

        config I2C_DEVICES_RTC_PCF8523
            bool "PCF8523"
            help
                Enable the PCF8523 RTC driver

        config I2C_DEVICES_RTC_PCF85063A
            bool "PCF85063A"
            help
                Enable the PCF85063A RTC driver

        config I2C_DEVICES_RTC_M41T81
            bool "M41T81"
            help
                Enable the M41T81 RTC driver

        config I2C_DEVICES_RTC_DS1307
            bool "DS1307"
            help
                Enable the DS1307 RTC driver

        config I2C_DEVICES_RTC_RX8010
            bool "RX8010"
            help
                Enable the RX8010 RTC driver
    endmenu

    config I2C_DEVICES_MCP4018
        bool "MCP4018 digital potentiometer"
        help
            Enable the MCP4018 I2C driver

    menu "IO expanders"
        config I2C_DEVICES_MCP23008
            bool "MCP23008 IO port"
            help
                Enable the MCP23008 I2C driver

        config I2C_DEVICES_TCA9534
            bool "TCA9534 IO port"
            help
                Enable the TCA9534 I2C driver
    endmenu

    menu "Proximity and Ambient Light Sensors"
        config I2C_DEVICES_LTR559ALS
            bool "LTR559ALS optical sensor"
            help
                Enable the LTR559ALS I2C driver

        config I2C_DEVICES_VCNL4010
            bool "VCNL4010 optical sensor"
            help
                Enable the VCNL4010 I2C driver
    endmenu

    menu "Touch sensors"
        config I2C_DEVICES_GT1151Q
            bool "GT1151Q capacitive touch screen reader"
            help
                Enable the GT1151Q I2C driver
    endmenu

    menu "Power"
        config I2C_DEVICES_BQ27441_G1
            bool "BQ27441-G1 fuel gauge"
            help
                Enable the BQ27441-G1 fuel gauge

        config I2C_DEVICES_SGM41513D
            bool "SGM41513D charging IC"
            help
                Enable the SGM41513D charging IC
    endmenu

    menu "Ports"
        config I2C_DEVICES_PIC_BITBANG_PORT
            bool "PIC24 bitbang driver"
        config I2C_DEVICES_ESP_IDF_PORT
            bool "ESP-IDF i2c driver"
    endmenu

endmenu
```
